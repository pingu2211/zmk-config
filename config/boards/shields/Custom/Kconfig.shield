## config/boards/shields/Custom/Kconfig.shield
```kconfig
config SHIELD_CUSTOMFLIP_LEFT
    def_bool $(shields_list_contains,customflip_left)

config SHIELD_CUSTOMFLIP_RIGHT
    def_bool $(shields_list_contains,customflip_right)
```

## config/boards/shields/customflip/Kconfig.defconfig
```kconfig
if SHIELD_CUSTOMFLIP_LEFT

config ZMK_KEYBOARD_NAME
    default "Brendan's KBD"

if ZMK_BACKLIGHT

config LED_GPIO
    default y

endif # ZMK_BACKLIGHT

config ZMK_SPLIT_ROLE_CENTRAL
    default y

endif

if SHIELD_CUSTOMFLIP_LEFT || SHIELD_CUSTOMFLIP_RIGHT

config ZMK_SPLIT
    default y

endif
```
